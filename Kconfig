## Kconfig
```kconfig
DT_COMPAT_ZMK_BEHAVIOR_AUTO_SHIFT := zmk,behavior-auto-shift

config ZMK_AUTO_SHIFT
    bool "Global auto shift"
    default $(dt_compat_enabled,$(DT_COMPAT_ZMK_BEHAVIOR_AUTO_SHIFT))
    depends on !ZMK_SPLIT || ZMK_SPLIT_ROLE_CENTRAL
    help
      QMK-style global auto shift: holding an eligible key past the tapping term
      types its shifted variant.
```

## dts/bindings/behaviors/zmk,behavior-auto-shift.yaml
```yaml
description: Global auto shift toggle

compatible: "zmk,behavior-auto-shift"

include: zero_param.yaml

properties:
  tapping-term-ms:
    type: int
    default: 170
    description: Hold time after which an eligible key is sent shifted.
  enabled-on-boot:
    type: boolean
    description: Start with auto shift enabled.
```
